## firmware/tests/configs/stm32f072_mellow_fly_d5_runtime_motion_5axis_tmc2209_defconfig
```kconfig
# Mellow FLY-D5 五轴 TMC2209、运行时清单与 Katapult 压力配置。
CONFIG_BOARD_STM32F072RBT6=y
CONFIG_BOARD_MELLOW_FLY_D5=y
CONFIG_F072_CLOCK_HSE_8MHZ=y
CONFIG_F072_RESERVE_KATAPULT_USB_PINS=y
CONFIG_SYSTEM_CLOCK_HZ=48000000
CONFIG_FIRMWARE_VERSION_MAJOR=0
CONFIG_FIRMWARE_VERSION_MINOR=1
CONFIG_FIRMWARE_VERSION_PATCH=0
CONFIG_BOARD_TYPE=0xF072D5
CONFIG_NODE_PROVISIONAL_ID=1
CONFIG_CAN_PINS_PB8_PB9=y
CONFIG_CAN_NOMINAL_BITRATE=1000000
CONFIG_REMOTE_MAX_PACKET_SIZE=2048
CONFIG_REMOTE_REQUEST_CACHE_ENTRIES=8
CONFIG_REMOTE_CACHE_RESPONSE_SIZE=256
CONFIG_REMOTE_REASSEMBLY_SLOTS=2
CONFIG_REMOTE_REASSEMBLY_TIMEOUT_MS=500
CONFIG_HEARTBEAT_INTERVAL_MS=500
CONFIG_REMOTEBSP_RUNTIME_CONFIG=y
CONFIG_RUNTIME_CONFIG_MAX_SIZE=1024
CONFIG_RUNTIME_CONFIG_MAX_ENTRIES=32
CONFIG_GPIO_RESOURCE_COUNT=16
CONFIG_HARDWARE_UART_RESOURCE_COUNT=0
CONFIG_REMOTEBSP_SOFT_HALF_DUPLEX_UART=y
CONFIG_SOFT_HALF_DUPLEX_UART_BAUD=40000
CONFIG_SOFT_HALF_DUPLEX_UART_RX_BUFFER_SIZE=64
CONFIG_SOFT_HALF_DUPLEX_UART_PORT_COUNT=5
CONFIG_REMOTEBSP_MOTION=y
CONFIG_REMOTEBSP_TMC2209_UART=y
CONFIG_TMC2209_UART_PORT_CAPACITY=5
CONFIG_MOTION_SLOT0_ENABLED=y
CONFIG_MOTION_SLOT0_STEP_PIN_PC15=y
CONFIG_MOTION_SLOT0_DIR_PIN_PC14=y
CONFIG_MOTION_SLOT0_ENABLE_PIN_PC2=y
CONFIG_MOTION_SLOT0_ENABLE_ACTIVE_LOW_SETTING=y
CONFIG_MOTION_SLOT0_DRIVER_TMC2209_UART=y
CONFIG_MOTION_SLOT0_TMC_UART_PIN_PC13=y
CONFIG_MOTION_SLOT0_LIMIT_PIN_PB4=y
CONFIG_MOTION_SLOT1_ENABLED=y
CONFIG_MOTION_SLOT1_STEP_PIN_PA1=y
CONFIG_MOTION_SLOT1_DIR_PIN_PA0=y
CONFIG_MOTION_SLOT1_ENABLE_PIN_PA2=y
CONFIG_MOTION_SLOT1_ENABLE_ACTIVE_LOW_SETTING=y
CONFIG_MOTION_SLOT1_DRIVER_TMC2209_UART=y
CONFIG_MOTION_SLOT1_TMC_UART_PIN_PC3=y
CONFIG_MOTION_SLOT1_LIMIT_PIN_PB3=y
CONFIG_MOTION_SLOT2_ENABLED=y
CONFIG_MOTION_SLOT2_STEP_PIN_PA5=y
CONFIG_MOTION_SLOT2_DIR_PIN_PA4=y
CONFIG_MOTION_SLOT2_ENABLE_PIN_PA6=y
CONFIG_MOTION_SLOT2_ENABLE_ACTIVE_LOW_SETTING=y
CONFIG_MOTION_SLOT2_DRIVER_TMC2209_UART=y
CONFIG_MOTION_SLOT2_TMC_UART_PIN_PA3=y
CONFIG_MOTION_SLOT2_LIMIT_PIN_PD2=y
CONFIG_MOTION_SLOT3_ENABLED=y
CONFIG_MOTION_SLOT3_STEP_PIN_PB10=y
CONFIG_MOTION_SLOT3_DIR_PIN_PB2=y
CONFIG_MOTION_SLOT3_ENABLE_PIN_PB11=y
CONFIG_MOTION_SLOT3_ENABLE_ACTIVE_LOW_SETTING=y
CONFIG_MOTION_SLOT3_DRIVER_TMC2209_UART=y
CONFIG_MOTION_SLOT3_TMC_UART_PIN_PB1=y
CONFIG_MOTION_SLOT3_LIMIT_PIN_NONE=y
CONFIG_MOTION_SLOT4_ENABLED=y
CONFIG_MOTION_SLOT4_STEP_PIN_PC5=y
CONFIG_MOTION_SLOT4_DIR_PIN_PC4=y
CONFIG_MOTION_SLOT4_ENABLE_PIN_PB0=y
CONFIG_MOTION_SLOT4_ENABLE_ACTIVE_LOW_SETTING=y
CONFIG_MOTION_SLOT4_DRIVER_TMC2209_UART=y
CONFIG_MOTION_SLOT4_TMC_UART_PIN_PA7=y
CONFIG_MOTION_SLOT4_LIMIT_PIN_NONE=y
CONFIG_MOTION_MAX_AXES=5
CONFIG_MOTION_QUEUE_DEPTH=8
CONFIG_MOTION_MIN_LEAD_TIME_US=2000
CONFIG_MOTION_MAX_STEP_RATE_HZ=30000
CONFIG_MOTION_MAX_TOTAL_STEP_RATE_HZ=30000
CONFIG_MOTION_STEP_PULSE_WIDTH_US=8
CONFIG_MOTION_MIN_STEP_LOW_US=8
CONFIG_MOTION_DIRECTION_SETUP_US=8
CONFIG_MOTION_COMPARE_MIN_LEAD_US=4
CONFIG_MOTION_MAX_COMPARE_LATENESS_US=50
CONFIG_APP_LAYOUT_KATAPULT_8K=y
CONFIG_APPLICATION_FLASH_OFFSET=0x2000
```

## firmware/tests/configs/stm32f103_bus_hal_defconfig
```kconfig
# F103 单板 I2C/SPI HAL 交叉编译配置；默认产品配置仍关闭 BUS。
CONFIG_BOARD_STM32F103CBT6=y
CONFIG_F103_CLOCK_HSE_8MHZ=y
CONFIG_SYSTEM_CLOCK_HZ=72000000
CONFIG_BOARD_TYPE=0x0103CB
CONFIG_NODE_PROVISIONAL_ID=1
CONFIG_CAN_PINS_PA11_PA12=y
CONFIG_CAN_NOMINAL_BITRATE=500000
CONFIG_REMOTE_MAX_PACKET_SIZE=2048
CONFIG_REMOTE_REQUEST_CACHE_ENTRIES=8
CONFIG_REMOTE_CACHE_RESPONSE_SIZE=256
CONFIG_REMOTE_REASSEMBLY_SLOTS=2
CONFIG_REMOTE_REASSEMBLY_TIMEOUT_MS=500
CONFIG_HEARTBEAT_INTERVAL_MS=500
CONFIG_GPIO_RESOURCE_COUNT=8
CONFIG_HARDWARE_UART_RESOURCE_COUNT=1
CONFIG_UART0_PINS_PA9_PA10=y
CONFIG_UART_RX_BUFFER_SIZE=256
CONFIG_UART_TX_BUFFER_SIZE=256
CONFIG_REMOTEBSP_BUS=y
CONFIG_REMOTEBSP_BUS_RESOURCE_COUNT=4
CONFIG_REMOTEBSP_BUS_MAX_TRANSFER_BYTES=128
CONFIG_REMOTEBSP_BUS_MIN_TIMEOUT_US=100
CONFIG_REMOTEBSP_BUS_MAX_TIMEOUT_US=100000
CONFIG_F103_BUS_I2C1_PB6_PB7=y
CONFIG_F103_BUS_I2C1_DEVICE_ADDRESS=72
CONFIG_F103_BUS_SPI1_PA5_PA6_PA7_CS_PA4=y
CONFIG_REMOTEBSP_PWM=n
CONFIG_REMOTEBSP_TIMED_BITSTREAM=n
CONFIG_REMOTEBSP_MOTION=n
CONFIG_APP_LAYOUT_STANDALONE=y
CONFIG_APPLICATION_FLASH_OFFSET=0x0
```

## firmware/tests/configs/stm32g431_weact_core_bus_hal_defconfig
```kconfig
# G431 单板 I2C/SPI HAL 交叉编译配置；仅用于开发验证，不是正式板卡预设。
# SPI1 使用 PA6，因此不得在逻辑分析仪 PWM 接线保持连接时烧录此固件。
CONFIG_BOARD_STM32G431CBU6=y
CONFIG_BOARD_WEACT_G431_CORE_V10=y
CONFIG_G431_CLOCK_HSE_8MHZ=y
CONFIG_BOARD_HAS_LSE_32768=y
CONFIG_STARTUP_GPIO_OUTPUT_LOW="PC6"
CONFIG_STARTUP_GPIO_INPUT_PULLDOWN="PC13"
CONFIG_SYSTEM_CLOCK_HZ=170000000
CONFIG_FIRMWARE_VERSION_MAJOR=0
CONFIG_FIRMWARE_VERSION_MINOR=1
CONFIG_FIRMWARE_VERSION_PATCH=0
CONFIG_BOARD_TYPE=0x0431CB
CONFIG_NODE_PROVISIONAL_ID=1
CONFIG_CAN_PINS_PB8_PB9=y
CONFIG_CAN_NOMINAL_BITRATE=500000
CONFIG_CAN_FD_ENABLE=y
CONFIG_CAN_FD_DATA_BITRATE=1000000
CONFIG_REMOTE_MAX_PACKET_SIZE=2048
CONFIG_REMOTE_REQUEST_CACHE_ENTRIES=16
CONFIG_REMOTE_CACHE_RESPONSE_SIZE=256
CONFIG_REMOTE_REASSEMBLY_SLOTS=2
CONFIG_REMOTE_REASSEMBLY_TIMEOUT_MS=500
CONFIG_HEARTBEAT_INTERVAL_MS=500
CONFIG_GPIO_RESOURCE_COUNT=8
CONFIG_REMOTEBSP_BUS=y
CONFIG_REMOTEBSP_BUS_RESOURCE_COUNT=6
CONFIG_REMOTEBSP_BUS_MAX_TRANSFER_BYTES=128
CONFIG_REMOTEBSP_BUS_MIN_TIMEOUT_US=100
CONFIG_REMOTEBSP_BUS_MAX_TIMEOUT_US=100000
CONFIG_G431_BUS_I2C1_PB6_PB7=y
CONFIG_G431_BUS_I2C1_DEVICE_ADDRESS=72
CONFIG_G431_BUS_SPI1_PA5_PA6_PA7_CS_PA15=y
CONFIG_G431_BUS_SPI2_PB13_PB14_PB15_CS_PB12=y
CONFIG_HARDWARE_UART_RESOURCE_COUNT=1
CONFIG_UART0_PINS_PA9_PA10=y
CONFIG_UART_RX_BUFFER_SIZE=256
CONFIG_UART_TX_BUFFER_SIZE=256
CONFIG_REMOTEBSP_PWM=n
CONFIG_REMOTEBSP_TIMED_BITSTREAM=n
CONFIG_REMOTEBSP_MOTION=n
CONFIG_APP_LAYOUT_STANDALONE=y
CONFIG_APPLICATION_FLASH_OFFSET=0x0
```

## firmware/tests/configs/stm32g431_weact_core_motion_1axis_tmc2209_defconfig
```kconfig
# WeAct STM32G431CBU6 Core 单轴 TMC2209 编译与实板验收配置。
CONFIG_BOARD_STM32G431CBU6=y
CONFIG_BOARD_WEACT_G431_CORE_V10=y
CONFIG_G431_CLOCK_HSE_8MHZ=y
CONFIG_BOARD_HAS_LSE_32768=y
CONFIG_WEACT_G431_PC6_PWM_BREATHING_LED=y
CONFIG_STARTUP_GPIO_OUTPUT_LOW="PC6"
CONFIG_STARTUP_GPIO_OUTPUT_HIGH=""
CONFIG_STARTUP_GPIO_INPUT_PULLDOWN="PC13"
CONFIG_SYSTEM_CLOCK_HZ=170000000
CONFIG_FIRMWARE_VERSION_MAJOR=0
CONFIG_FIRMWARE_VERSION_MINOR=1
CONFIG_FIRMWARE_VERSION_PATCH=0
CONFIG_BOARD_TYPE=0x0431CB
CONFIG_NODE_PROVISIONAL_ID=1
CONFIG_CAN_PINS_PB8_PB9=y
CONFIG_CAN_NOMINAL_BITRATE=500000
CONFIG_CAN_FD_ENABLE=n
CONFIG_REMOTE_MAX_PACKET_SIZE=2048
CONFIG_REMOTE_REQUEST_CACHE_ENTRIES=16
CONFIG_REMOTE_CACHE_RESPONSE_SIZE=256
CONFIG_REMOTE_REASSEMBLY_SLOTS=2
CONFIG_REMOTE_REASSEMBLY_TIMEOUT_MS=500
CONFIG_HEARTBEAT_INTERVAL_MS=500
CONFIG_REMOTEBSP_RUNTIME_CONFIG=y
CONFIG_RUNTIME_CONFIG_MAX_SIZE=2024
CONFIG_RUNTIME_CONFIG_MAX_ENTRIES=32
CONFIG_GPIO_RESOURCE_COUNT=8
CONFIG_HARDWARE_UART_RESOURCE_COUNT=0
CONFIG_UART_RX_BUFFER_SIZE=1024
CONFIG_UART_TX_BUFFER_SIZE=1024
CONFIG_REMOTEBSP_MOTION=y
CONFIG_REMOTEBSP_TMC2209_UART=y
CONFIG_TMC2209_UART_PORT_CAPACITY=1
CONFIG_MOTION_SLOT0_ENABLED=y
CONFIG_MOTION_SLOT0_STEP_PIN_PA0=y
CONFIG_MOTION_SLOT0_DIR_PIN_PA1=y
CONFIG_MOTION_SLOT0_ENABLE_PIN_PA2=y
CONFIG_MOTION_SLOT0_DRIVER_TMC2209_UART=y
CONFIG_MOTION_SLOT0_TMC_UART_PIN_PA3=y
CONFIG_MOTION_SLOT0_DIR_INVERTED=n
CONFIG_MOTION_SLOT0_ENABLE_ACTIVE_LOW_SETTING=y
CONFIG_MOTION_SLOT0_LIMIT_PIN_NONE=y
CONFIG_MOTION_SLOT1_ENABLED=n
CONFIG_MOTION_SLOT2_ENABLED=n
CONFIG_MOTION_SLOT3_ENABLED=n
CONFIG_MOTION_SLOT4_ENABLED=n
CONFIG_MOTION_MAX_AXES=1
CONFIG_MOTION_QUEUE_DEPTH=8
CONFIG_MOTION_MIN_LEAD_TIME_US=2000
CONFIG_MOTION_MAX_STEP_RATE_HZ=10000
CONFIG_MOTION_MAX_TOTAL_STEP_RATE_HZ=10000
CONFIG_MOTION_STEP_PULSE_WIDTH_US=2
CONFIG_MOTION_MIN_STEP_LOW_US=2
CONFIG_MOTION_DIRECTION_SETUP_US=2
CONFIG_MOTION_COMPARE_MIN_LEAD_US=1
CONFIG_MOTION_MAX_COMPARE_LATENESS_US=10
CONFIG_APP_LAYOUT_STANDALONE=y
CONFIG_APPLICATION_FLASH_OFFSET=0x0
```
