## firmware/Kconfig
```kconfig
mainmenu "Remote BSP 工具板固件配置"

config EXPERT_CONFIG
    bool "显示专家级容量与时序设置"
    default n
    help
      普通构建使用各 MCU 已验证的默认预算即可。只有在完成 SRAM、总线负载和
      实板时序验证后才应调整专家参数。

menu "目标硬件"

choice
    prompt "目标 MCU"
    default BOARD_STM32F103CBT6

config BOARD_STM32F103CBT6
    bool "STM32F103CBT6（128KB Flash / 20KB SRAM / bxCAN）"

config BOARD_STM32F072RBT6
    bool "STM32F072RBT6（128KB Flash / 16KB SRAM / bxCAN）"

config BOARD_STM32G431CBU6
    bool "STM32G431CBU6（128KB Flash / 32KB SRAM / FDCAN）"
endchoice

choice
    prompt "STM32F072RBT6 板型"
    depends on BOARD_STM32F072RBT6
    default BOARD_STM32F072RBT6_GENERIC

config BOARD_STM32F072RBT6_GENERIC
    bool "通用 STM32F072RBT6"

config BOARD_MELLOW_FLY_D5
    bool "Mellow FLY-D5"
    help
      仅为已知的 FLY-D5 接线预填 8MHz HSE、PB8/PB9 CAN、USB 保留和五个运动槽的
      默认引脚。通用 STM32F072RBT6 仍可手工配置相同功能。

endchoice

choice
    prompt "STM32F103CBT6 板型"
    depends on BOARD_STM32F103CBT6
    default BOARD_STM32F103CBT6_GENERIC

config BOARD_STM32F103CBT6_GENERIC
    bool "通用 STM32F103CBT6"

config BOARD_WEACT_BLUEPILL_PLUS
    bool "WeAct BluePill Plus"
    help
      PA0 为高电平按下的用户按键，使用 MCU 内部下拉；PB2 为高电平点亮
      的蓝色 LED；PA11/PA12 分别为 USB DM/DP。OSC_IN/OSC_OUT 接 8MHz
      HSE，PC14/PC15 接 32.768kHz LSE。

endchoice

choice F103_CLOCK_SOURCE
    prompt "STM32F103 系统时钟源"
    depends on BOARD_STM32F103CBT6
    default F103_CLOCK_HSE_8MHZ if BOARD_WEACT_BLUEPILL_PLUS
    default F103_CLOCK_HSI8

config F103_CLOCK_HSI8
    bool "内部 HSI8（PLL 到 64MHz）"
    help
      供没有外部高速晶振的通用核心板使用。SYSCLK 为 64MHz，APB1 和 bxCAN
      时钟为 32MHz。内部 RC 的频率精度和温漂不如外部晶振，不建议用于高速、
      长线或节点较多的 CAN 网络。

config F103_CLOCK_HSE_8MHZ
    bool "外部 8MHz HSE（PLL 到 72MHz，推荐）"
    help
      SYSCLK 为 72MHz，APB1 和 bxCAN 时钟为 36MHz。WeAct BluePill Plus
      默认选择本项；CAN 通讯和运动定时优先使用外部晶振。

endchoice

choice
    prompt "STM32G431CBU6 板型"
    depends on BOARD_STM32G431CBU6
    default BOARD_STM32G431CBU6_GENERIC

config BOARD_STM32G431CBU6_GENERIC
    bool "通用 STM32G431CBU6"

config BOARD_WEACT_G431_CORE_V10
    bool "WeAct STM32G431CBU6 Core"
    help
      PB8/BOOT0 带 10k 下拉，PB8/PB9 用于 FDCAN；PA11/PA12 用于
      USB DM/DP。PC13 用户按键高电平有效且无外部上下拉，PC6 蓝色
      LED 高电平点亮。PF0/PF1 接 8MHz HSE，PC14/PC15 接 32.768kHz LSE。

endchoice

config BOARD_HAS_LSE_32768
    bool "板卡安装 32.768kHz LSE 晶振"
    depends on BOARD_STM32F103CBT6 || BOARD_STM32G431CBU6
    default y if BOARD_WEACT_BLUEPILL_PLUS || BOARD_WEACT_G431_CORE_V10
    default n
    help
      声明 PC14/PC15 已连接低速外部晶振，并从 GPIO、运动和软件 UART 的
      可选引脚中保留它们。当前 APP 尚未使用 RTC/低功耗守时，因此只记录并
      保护这项硬件资源，不会无意义地启动 LSE；未来时间同步保持模块启用时
      再由该模块启动并检测 LSE。

choice F072_CLOCK_SOURCE
    prompt "STM32F072 系统时钟源"
    depends on BOARD_STM32F072RBT6
    default F072_CLOCK_HSE_8MHZ if BOARD_MELLOW_FLY_D5
    default F072_CLOCK_HSI48

config F072_CLOCK_HSI48
    bool "内部 HSI48"

config F072_CLOCK_HSE_8MHZ
    bool "外部 8MHz HSE（PLL 到 48MHz）"
    help
      本板默认使用 8MHz 外部晶振。CAN 使用外部晶振可满足 1Mbit/s 对节点时钟
      误差的要求；选择该项时 SYSCLK/PCLK1 仍为 48MHz。

endchoice

config F072_RESERVE_KATAPULT_USB_PINS
    bool "保留 PA11/PA12 给 Katapult USB 恢复口"
    depends on BOARD_STM32F072RBT6
    default y if BOARD_MELLOW_FLY_D5
    default n
    help
      启用后，普通 GPIO 与运动槽配置均不能占用 PA11/PA12。该选项只描述
      Katapult 应急恢复口的板级占用，不会把 USB 协议栈链接进 APP；FLY-D5
      默认映射会自动启用本项。

choice
    prompt "STM32G431 系统时钟源"
    depends on BOARD_STM32G431CBU6
    default G431_CLOCK_HSE_8MHZ if BOARD_WEACT_G431_CORE_V10
    default G431_CLOCK_HSI16

config G431_CLOCK_HSI16
    bool "内部 HSI16"

config G431_CLOCK_HSE_8MHZ
    bool "外部 8MHz HSE"
endchoice

menu "开发与板卡自检"

config WEACT_G431_PC6_PWM_BREATHING_LED
    bool "WeAct G431 PC6 PWM 呼吸灯演示"
    depends on BOARD_WEACT_G431_CORE_V10 && !REMOTEBSP_PWM
    default n
    help
      使用 TIM3_CH1（PC6，AF2）输出 10kHz PWM。亮度按约 4 秒一个
      周期缓慢起伏，用于验证定时器、PWM 输出和板载 LED。启用时 PC6
      被该演示独占，不能再作为远程 GPIO 使用；关闭后 PC6 恢复为普通 GPIO。

config WEACT_BLUEPILL_PLUS_PB2_BREATHING_LED
    bool "WeAct BluePill Plus PB2 软件呼吸灯演示"
    depends on BOARD_WEACT_BLUEPILL_PLUS
    default n
    help
      使用板载高电平点亮的 PB2 LED。PB2 不具备可直接使用的 PWM 输出通道，
      固件在主循环中依据 1ms 系统节拍产生约 100Hz 的软件 PWM，并按约 4 秒
      周期改变占空比。该实现不新增定时器中断，不影响 CAN 接收、UART 中断或
      可选的运动定时器。关闭后 PB2 保持熄灭，并继续保留为板载 LED。

endmenu

config SYSTEM_CLOCK_HZ
    int
    default 48000000 if BOARD_STM32F072RBT6
    default 72000000 if F103_CLOCK_HSE_8MHZ
    default 64000000 if F103_CLOCK_HSI8
    default 170000000 if BOARD_STM32G431CBU6

config FIRMWARE_VERSION_MAJOR
    int "固件主版本号"
    range 0 65535
    default 0

config FIRMWARE_VERSION_MINOR
    int "固件次版本号"
    range 0 65535
    default 1

config FIRMWARE_VERSION_PATCH
    int "固件修订版本号"
    range 0 65535
    default 0

config BOARD_TYPE
    hex
    default 0xF072D5 if BOARD_MELLOW_FLY_D5
    default 0x0072B6 if BOARD_STM32F072RBT6
    default 0x0103CB if BOARD_STM32F103CBT6
    default 0x0431CB if BOARD_STM32G431CBU6

config NODE_PROVISIONAL_ID
    int "未分配节点的临时编号"
    range 1 127
    default 1

endmenu

menu "主通信链路"

choice
    prompt "APP 主通信链路"
    default REMOTEBSP_TRANSPORT_CAN

config REMOTEBSP_TRANSPORT_CAN
    bool "CAN / CAN-FD"

config REMOTEBSP_TRANSPORT_USB
    bool "USB Vendor Bulk（STM32G431CBU6）"
    depends on BOARD_STM32G431CBU6
    help
      使用 PA11/PA12 作为 RemoteBSP 正常运行链路。已实现公共帧格式、Linux
      libusb 主机、Mock 端到端链路及 G431 USB Device Vendor Bulk 后端；实体
      G431 的枚举、重连和压力测试仍待实板验收。F072/F103 暂不开放本选项。

endchoice

config USB_VENDOR_ID
    hex "USB VID"
    default 0x1209
    depends on REMOTEBSP_TRANSPORT_USB
    help
      0x1209 仅作为开发占位值，发布产品前必须申请或使用合法分配的 VID/PID。

config USB_PRODUCT_ID
    hex "USB PID"
    default 0x0001
    depends on REMOTEBSP_TRANSPORT_USB

config USB_RX_BUFFER_SIZE
    int "USB 原始接收缓冲区" if EXPERT_CONFIG
    range 3072 8192
    default 3072
    depends on REMOTEBSP_TRANSPORT_USB
    help
      至少容纳一个最大 Remote Packet 拆分后的全部 RBU1 逻辑帧，避免主循环
      暂时繁忙时 Bulk OUT 连续到达造成半包丢失。

config USB_TX_BUFFER_SIZE
    int "USB 原始发送缓冲区" if EXPERT_CONFIG
    range 3072 8192
    default 3072
    depends on REMOTEBSP_TRANSPORT_USB
    help
      Remote Core 会连续提交同一响应的所有分片，因此缓冲必须容纳 2048 字节
      Remote Packet 加每个逻辑帧的 12 字节 RBU1 帧头。

endmenu

menu "CAN/CAN-FD"

depends on REMOTEBSP_TRANSPORT_CAN

choice
    prompt "CAN/FDCAN 引脚组"
    default CAN_PINS_PB8_PB9 if BOARD_MELLOW_FLY_D5
    default CAN_PINS_PB8_PB9 if BOARD_WEACT_G431_CORE_V10
    default CAN_PINS_PA11_PA12

config CAN_PINS_PA11_PA12
    bool "PA11=RX、PA12=TX"

config CAN_PINS_PB8_PB9
    bool "PB8=RX、PB9=TX"
endchoice

config CAN_NOMINAL_BITRATE
    int "CAN 仲裁段波特率"
    range 10000 1000000
    default 1000000 if BOARD_MELLOW_FLY_D5
    default 500000

config CAN_FD_ENABLE
    bool "启用 CAN-FD"
    default y if BOARD_STM32G431CBU6
    depends on BOARD_STM32G431CBU6

config CAN_FD_DATA_BITRATE
    int "CAN-FD 数据段波特率"
    range 1000000 8000000
    default 1000000
    depends on CAN_FD_ENABLE

config CAN_TRANSCEIVER_STB_ENABLE
    bool "使用 GPIO 控制收发器 STB"
    default n

config CAN_TRANSCEIVER_STB_PORT
    string "STB GPIO 端口"
    default "B"
    depends on CAN_TRANSCEIVER_STB_ENABLE

config CAN_TRANSCEIVER_STB_PIN
    int "STB GPIO 引脚号"
    range 0 15
    default 0
    depends on CAN_TRANSCEIVER_STB_ENABLE

endmenu

menu "远程协议与内存预算"

config REMOTE_BUDGET_EDIT
    bool "编辑远程协议与内存预算"
    default n
    help
      默认值已经按当前三类 MCU 做过保守配置。只有需要改变最大包长、缓存数量
      或时序参数时才开启；下方每个选项都会显示用途和主要内存代价。

comment "当前使用经过验证的安全默认值；开启上面的开关后可查看和修改"
    depends on !REMOTE_BUDGET_EDIT && !EXPERT_CONFIG

config REMOTE_MAX_PACKET_SIZE
    int "最大远程协议包长度" if EXPERT_CONFIG || REMOTE_BUDGET_EDIT
    range 256 2048
    default 2048 if BOARD_STM32F072RBT6
    default 2048 if BOARD_STM32F103CBT6
    default 2048 if BOARD_STM32G431CBU6

config REMOTE_REQUEST_CACHE_ENTRIES
    int "请求去重缓存条目数" if EXPERT_CONFIG || REMOTE_BUDGET_EDIT
    range 2 32
    default 8 if BOARD_STM32F072RBT6
    default 8 if BOARD_STM32F103CBT6
    default 16 if BOARD_STM32G431CBU6

config REMOTE_CACHE_RESPONSE_SIZE
    int "单条去重缓存的最大响应长度" if EXPERT_CONFIG || REMOTE_BUDGET_EDIT
    range 64 512
    default 256
    help
      此长度包含 24 字节远程协议头。会消耗数据或产生副作用的命令，
      必须把完整响应限制在此长度内，才能保证重试不会重复执行操作。

config REMOTE_REASSEMBLY_SLOTS
    int "并行分片重组槽数量" if EXPERT_CONFIG || REMOTE_BUDGET_EDIT
    range 1 4
    default 2

config REMOTE_REASSEMBLY_TIMEOUT_MS
    int "分片重组超时（毫秒）" if EXPERT_CONFIG || REMOTE_BUDGET_EDIT
    range 50 5000
    default 500

config HEARTBEAT_INTERVAL_MS
    int "心跳间隔（毫秒）" if EXPERT_CONFIG || REMOTE_BUDGET_EDIT
    range 100 2000
    default 500

config REMOTEBSP_DEVICE_PARAMS
    bool "保存设备身份、制造信息和校准参数"
    default y
    help
      在芯片内部Flash末尾保留两个擦除页，使用掉电安全的快照日志保存
      SN、UUID、硬件版本、制造批次、设备名称和ADC校准值。这里不保存
      GPIO、UART、运动轴等资源映射；资源映射由Studio生成并编译进固件。
      存储接口与介质无关，可替换为外部EEPROM而不修改远程协议。

choice REMOTEBSP_DEVICE_PARAM_BACKEND
    prompt "设备参数存储后端"
    depends on REMOTEBSP_DEVICE_PARAMS
    default REMOTEBSP_DEVICE_PARAM_INTERNAL_FLASH

config REMOTEBSP_DEVICE_PARAM_INTERNAL_FLASH
    bool "内部Flash双页（默认）"

config REMOTEBSP_DEVICE_PARAM_EXTERNAL_EEPROM
    bool "板级注入的外部EEPROM"
    help
      仅启用通用read/write/erase-or-fill回调适配层；板级代码必须提供实际
      介质回调。本选项不包含I2C、SPI或厂商器件协议。
endchoice

config REMOTEBSP_DEVICE_PARAM_EEPROM_PAGE_SIZE
    int "外部EEPROM逻辑页大小"
    depends on REMOTEBSP_DEVICE_PARAM_EXTERNAL_EEPROM
    range 512 4096
    default 512

config REMOTEBSP_DEVICE_PARAM_COMMIT_BUDGET
    int "设备参数终身提交预算"
    depends on REMOTEBSP_DEVICE_PARAMS
    range 1 10000
    default 10000
    help
      固件允许的持久快照generation上限。只能在构建时选择，运行期只能进一步
      收紧，不能放宽；设备参数禁止承载高频遥测。

endmenu

menu "通用硬件资源"

menu "上电 IO 安全状态"

config REMOTEBSP_STATIC_GPIO_MAP
    bool "只允许访问已声明的 GPIO"
    default n
    help
      RemoteBSP Studio生成的产品固件应启用本项。启用后，GPIO_CREATE只能访问
      下方五个上电状态列表中的引脚，并且请求方向必须与列表声明一致。关闭时
      保留核心板调试固件的兼容行为，由板级驱动决定引脚是否合法。

config STARTUP_GPIO_OUTPUT_LOW
    string "启动后输出低的引脚列表"
    default ""
    help
      使用逗号分隔，例如 PA1,PB2。固件会先写入低电平锁存值，再把引脚
      切换为推挽输出，避免切换过程产生高电平毛刺。

config STARTUP_GPIO_OUTPUT_HIGH
    string "启动后输出高的引脚列表"
    default ""
    help
      使用逗号分隔，例如 PA3,PC13。固件会先写入高电平锁存值，再把引脚
      切换为推挽输出。

config STARTUP_GPIO_INPUT_FLOATING
    string "启动后浮空输入的引脚列表"
    default ""

config STARTUP_GPIO_INPUT_PULLUP
    string "启动后上拉输入的引脚列表"
    default ""

config STARTUP_GPIO_INPUT_PULLDOWN
    string "启动后下拉输入的引脚列表"
    default ""
    help
      五个列表都使用 PA0,PB2 形式。同一引脚不能重复，SWD、CAN、USB、UART
      等保留引脚不能配置；非法配置会让固件进入安全故障状态。

endmenu

config GPIO_RESOURCE_COUNT
    int "编译期最大 GPIO 资源数"
    range 0 32
    default 16 if BOARD_MELLOW_FLY_D5
    default 8

config GPIO_INPUT_EVENT_QUEUE_CAPACITY
    int "每个 GPIO 输入对象的本地事件队列容量"
    range 1 16
    default 2
    depends on GPIO_RESOURCE_COUNT > 0
    help
      输入去抖后的稳定边沿先进入固定容量本地队列，再由主循环上报。
      队列满时丢弃最新事件并累计溢出计数，不在中断中解析或发送协议。

config REMOTEBSP_GPIO_EXTI
    bool "启用显式静态 GPIO EXTI 端点"
    default n
    depends on REMOTEBSP_STATIC_GPIO_MAP && GPIO_RESOURCE_COUNT > 0
    help
      仅供能力目录标记为implemented并由Studio生成的独立EXTI端点使用。
      不会把普通GPIO输入隐式改为中断输入；未启用时不编译mailbox或板级IRQ状态。

config GPIO_EXTI_MAILBOX_CAPACITY
    int "GPIO EXTI ISR mailbox容量"
    range 1 16
    default 2
    depends on REMOTEBSP_GPIO_EXTI
    help
      ISR只投递静态编码引脚，满时丢弃最新提示并饱和累计计数。

config GPIO_EXTI0_PA0
    bool "F103 PA0 / EXTI0"
    default n
    depends on REMOTEBSP_GPIO_EXTI && BOARD_STM32F103CBT6

config GPIO_EXTI13_PC13
    bool "G431 PC13 / EXTI13"
    default n
    depends on REMOTEBSP_GPIO_EXTI && BOARD_STM32G431CBU6

config HARDWARE_UART_RESOURCE_COUNT
    int "编译期最大硬件 UART 资源数"
    range 0 3 if BOARD_STM32F103CBT6 || BOARD_STM32G431CBU6
    range 0 1 if BOARD_STM32F072RBT6
    default 0 if BOARD_MELLOW_FLY_D5
    default 1 if BOARD_STM32F072RBT6
    default 3 if BOARD_STM32F103CBT6
    default 3 if BOARD_STM32G431CBU6
    help
      F072 后端实现一组 USART1；F103 后端依次提供 USART1、USART2、USART3，
      G431后端同样依次提供USART1、USART2、USART3。数量设为1/2/3时只链接并
      占用对应的前N组资源。
      TMC2209单线通讯不计入这里，而是由智能运动菜单独立裁剪。

config UART_RESOURCE_COUNT
    int
    default HARDWARE_UART_RESOURCE_COUNT
    help
      生成配置头时自动派生为“硬件 UART 数量 + TMC2209 单线端口容量”。
      此兼容符号供当前 Remote Core 分配逻辑 UART 对象，不能手工设置。

choice UART0_PINS
    prompt "UART 0（USART1）引脚"
    depends on (BOARD_STM32F072RBT6 || BOARD_STM32F103CBT6 || BOARD_STM32G431CBU6) && HARDWARE_UART_RESOURCE_COUNT > 0
    default UART0_PINS_PA9_PA10

config UART0_PINS_PA9_PA10
    bool "USART1：PA9(TX) / PA10(RX)"

config UART0_PINS_PB6_PB7
    bool "USART1 重映射：PB6(TX) / PB7(RX)"

endchoice

config UART1_PINS_PA2_PA3
    bool
    default y
    depends on (BOARD_STM32F103CBT6 || BOARD_STM32G431CBU6) && HARDWARE_UART_RESOURCE_COUNT > 1
    help
      UART 1固定使用USART2：PA2(TX) / PA3(RX)。当前支持的F103/G431封装均
      不提供另一组完整且不占用SWD的有效端点，因此不显示无效候选项。

config UART2_PINS_PB10_PB11
    bool
    default y
    depends on (BOARD_STM32F103CBT6 || BOARD_STM32G431CBU6) && HARDWARE_UART_RESOURCE_COUNT > 2
    help
      UART 2固定使用USART3：PB10(TX) / PB11(RX)。G431虽然还可使用
      PC10/PC11，但当前板卡端点统一固定为PB10/PB11。

config UART_RX_BUFFER_SIZE
    int "每路硬件 UART RX 缓冲长度" if HARDWARE_UART_RESOURCE_COUNT > 0
    range 64 4096
    default 256 if BOARD_STM32F072RBT6
    default 256 if BOARD_STM32F103CBT6
    default 1024 if BOARD_STM32G431CBU6

config UART_TX_BUFFER_SIZE
    int "每路硬件 UART TX 缓冲长度" if HARDWARE_UART_RESOURCE_COUNT > 0
    range 64 4096
    default 256 if BOARD_STM32F072RBT6
    default 256 if BOARD_STM32F103CBT6
    default 1024 if BOARD_STM32G431CBU6

config UART_EVENT_CHUNK_SIZE
    int "UART 流式接收事件分批长度"
    range 8 256
    default 64
    depends on HARDWARE_UART_RESOURCE_COUNT > 0 || REMOTEBSP_TMC2209_UART
    help
      从硬件 RX 环形缓冲区批量取出数据并主动上报。
      数值越大，CAN 效率越高；数值越小，串口接收延迟越低。

config UART_EVENT_FLUSH_MS
    int "UART 流式接收最大合并延迟（毫秒）"
    range 1 100
    default 5
    depends on HARDWARE_UART_RESOURCE_COUNT > 0 || REMOTEBSP_TMC2209_UART
    help
      分批未满时，第一个字节最多等待此时间后上报。

config REMOTEBSP_SOFT_HALF_DUPLEX_UART
    bool
    default y if REMOTEBSP_TMC2209_UART
    default n
    depends on BOARD_STM32F072RBT6 || BOARD_STM32F103CBT6 || BOARD_STM32G431CBU6

config SOFT_HALF_DUPLEX_UART_BAUD
    int
    default 40000
    depends on REMOTEBSP_SOFT_HALF_DUPLEX_UART

config SOFT_HALF_DUPLEX_UART_RX_BUFFER_SIZE
    int
    range 16 256
    default 64
    depends on REMOTEBSP_SOFT_HALF_DUPLEX_UART

config SOFT_HALF_DUPLEX_UART_PORT_COUNT
    int
    range 1 5
    default TMC2209_UART_PORT_CAPACITY
    depends on REMOTEBSP_SOFT_HALF_DUPLEX_UART

config REMOTEBSP_BUS
    bool "编译 I2C/SPI 原子事务公共核心"
    default n
    depends on BOARD_STM32F072RBT6 || BOARD_STM32F103CBT6 || BOARD_STM32G431CBU6
    help
      只启用协议校验、静态合同、会话租约和 Core 到 HAL 的原子事务边界。
      板级代码还必须提供经审核的只读端点表和同步超时后端，否则 Core 初始化
      会失败且不会公布能力。当前正式板卡预设均保持关闭。

config REMOTEBSP_BUS_RESOURCE_COUNT
    int "I2C/SPI 总线和设备合同总数"
    range 1 16
    default 1
    depends on REMOTEBSP_BUS
    help
      这是编译期租约表容量。实际端点必须由 Studio 生成配置或板级只读表提供，
      数量不得超过本值；运行时不能添加端点或改变引脚复用。

config REMOTEBSP_BUS_MAX_TRANSFER_BYTES
    int "单次 I2C/SPI 原子事务最大字节数"
    range 1 128
    default 128
    depends on REMOTEBSP_BUS
    help
      I2C 按写入与读取字节数之和计，SPI 按发送与接收长度的较大者计。
      Core 还会按每个静态设备合同收紧。该值必须让完整响应进入请求去重缓存。

config REMOTEBSP_BUS_MIN_TIMEOUT_US
    int "总线事务最短超时（微秒）"
    range 100 100000
    default 100
    depends on REMOTEBSP_BUS

config REMOTEBSP_BUS_MAX_TIMEOUT_US
    int "总线事务最长超时（微秒）"
    range 100 100000
    default 100000
    depends on REMOTEBSP_BUS

config G431_BUS_I2C1_PB6_PB7
    bool "G431 I2C1：PB6=SCL、PB7=SDA"
    default n
    depends on REMOTEBSP_BUS && BOARD_STM32G431CBU6

config F072_BUS_I2C1_PB6_PB7
    bool "F072 I2C1：PB6=SCL、PB7=SDA"
    default n
    depends on REMOTEBSP_BUS && BOARD_STM32F072RBT6

config F072_BUS_I2C1_DEVICE_ADDRESS
    int "F072 I2C1 静态设备7位地址"
    range 1 127
    default 72
    depends on F072_BUS_I2C1_PB6_PB7

config F072_BUS_SPI1_PA5_PA6_PA7_CS_PA4
    bool "F072 SPI1：PA5/PA6/PA7，PA4片选"
    default n
    depends on REMOTEBSP_BUS && BOARD_STM32F072RBT6

config F103_BUS_I2C1_PB6_PB7
    bool "F103 I2C1：PB6=SCL、PB7=SDA"
    default n
    depends on REMOTEBSP_BUS && BOARD_STM32F103CBT6

config F103_BUS_I2C1_DEVICE_ADDRESS
    int "F103 I2C1 静态设备7位地址"
    range 1 127
    default 72
    depends on F103_BUS_I2C1_PB6_PB7

config F103_BUS_SPI1_PA5_PA6_PA7_CS_PA4
    bool "F103 SPI1：PA5/PA6/PA7，PA4片选"
    default n
    depends on REMOTEBSP_BUS && BOARD_STM32F103CBT6

config G431_BUS_I2C1_DEVICE_ADDRESS
    int "G431 I2C1 静态设备7位地址"
    range 1 127
    default 72
    depends on G431_BUS_I2C1_PB6_PB7

config G431_BUS_SPI1_PA5_PA6_PA7_CS_PA15
    bool "G431 SPI1：PA5/PA6/PA7，PA15片选"
    default n
    depends on REMOTEBSP_BUS && BOARD_STM32G431CBU6

config G431_BUS_SPI2_PB13_PB14_PB15_CS_PB12
    bool "G431 SPI2：PB13/PB14/PB15，PB12片选"
    default n
    depends on REMOTEBSP_BUS && BOARD_STM32G431CBU6

endmenu

menu "ADC（可选实验骨架）"

config REMOTEBSP_ADC
    bool "编译通用 ADC 原始码采样核心"
    default n
    depends on BOARD_STM32F072RBT6 || BOARD_STM32F103CBT6 || BOARD_STM32G431CBU6
    help
      仅编译协议、静态资源枚举和 BSP 回调边界。当前三块实体目标均未提供
      经 AF 与参考电压确认的板级采样后端，因此即使打开本项也不会公布 ADC
      能力或资源；Studio 在实体确认前同样不得提供 ADC 引脚候选。

config ADC_RESOURCE_COUNT
    int "ADC 静态端点编译期上限"
    range 1 16
    default 1
    depends on REMOTEBSP_ADC

endmenu

menu "Storage（可选实验骨架）"

config REMOTEBSP_STORAGE
    bool "编译通用块 Storage 核心"
    default n
    depends on BOARD_STM32F072RBT6 || BOARD_STM32F103CBT6 || BOARD_STM32G431CBU6
    help
      仅编译静态资源枚举、协议处理和 BSP 回调边界。板级代码必须提供与
      设备参数双页完全分离、边界已确认的专用块区域；没有完整资源表及
      Read/Erase/Program 回调时不会公布 Storage 能力或资源。Studio 当前
      不提供 Storage 候选。

config STORAGE_RESOURCE_COUNT
    int "Storage 静态端点编译期上限"
    range 1 4
    default 1
    depends on REMOTEBSP_STORAGE

endmenu

menu "Timer（可选实验骨架）"

config REMOTEBSP_TIMER
    bool "编译通用 Timer 测量与单次等待核心"
    default n
    depends on BOARD_STM32F072RBT6 || BOARD_STM32F103CBT6 || BOARD_STM32G431CBU6
    help
      仅编译静态资源枚举、协议处理和 BSP 回调边界。板级代码必须提供已经
      确认 AF、时钟、溢出行为和输入电气链路的完整端点；缺少资源表或执行
      回调时不会公布 Timer 能力或资源。Studio 当前不提供 Timer 候选。

config TIMER_RESOURCE_COUNT
    int "Timer 静态端点编译期上限"
    range 1 8
    default 1
    depends on REMOTEBSP_TIMER

endmenu

menu "PWM 与定时位流（可选）"

config REMOTEBSP_PWM
    bool "编译通用 PWM 输出模块"
    default n
    depends on BOARD_STM32F072RBT6 || BOARD_STM32F103CBT6 || BOARD_STM32G431CBU6
    help
      提供频率、占空比和有效极性可配置的远程 PWM 对象。关闭后不分配对象状态，
      板级定时器后端也不会接入 Remote Core。

config PWM_RESOURCE_COUNT
    int "PWM 通道编译期容量"
    range 1 1 if BOARD_STM32F072RBT6 || BOARD_STM32F103CBT6
    range 1 2 if BOARD_STM32G431CBU6
    default 1
    depends on REMOTEBSP_PWM

choice
    prompt "PWM 0 输出引脚"
    depends on REMOTEBSP_PWM
    default PWM0_PIN_PA6 if BOARD_STM32F072RBT6 || BOARD_STM32F103CBT6
    default PWM0_PIN_PB10 if BOARD_STM32G431CBU6 && PWM_RESOURCE_COUNT > 1
    default PWM0_PIN_PC6 if BOARD_STM32G431CBU6

config PWM0_PIN_PA6
    bool "PA6（TIM3_CH1）"
    depends on BOARD_STM32F072RBT6 || BOARD_STM32F103CBT6 || BOARD_STM32G431CBU6
    depends on PWM_RESOURCE_COUNT = 1
    depends on !REMOTEBSP_MOTION || !MOTION_PIN_PA6_USED_25

config PWM0_PIN_PC6
    bool "PC6（TIM3_CH1，WeAct G431 板载 LED）"
    depends on BOARD_STM32G431CBU6 && PWM_RESOURCE_COUNT = 1
    depends on !REMOTEBSP_MOTION || !MOTION_PIN_PC6_USED_25

config PWM0_PIN_PB10
    bool "PB10（TIM2_CH3，与 USART3 TX 互斥）"
    depends on BOARD_STM32G431CBU6 && PWM_RESOURCE_COUNT = 2
    depends on HARDWARE_UART_RESOURCE_COUNT < 3
    depends on !REMOTEBSP_MOTION

endchoice

config PWM1_PIN_PB11
    bool
    default y
    depends on PWM0_PIN_PB10 && PWM_RESOURCE_COUNT = 2
    help
      PWM 1 固定使用 PB11（TIM2_CH4）。它与 PWM 0 共享 TIM2 频率，且
      PB10/PB11 与 USART3 互斥，因此双 PWM 配置最多启用两路硬件 UART。

config PWM_MAX_FREQUENCY_HZ
    int "PWM 允许的最高频率（Hz）"
    range 1000 2000000
    default 100000
    depends on REMOTEBSP_PWM
    help
      这是协议校验上限，不代表每个引脚都能达到该频率；最终仍由所选定时器时钟和
      计数器分辨率决定。

config REMOTEBSP_TIMED_BITSTREAM
    bool "编译定时位流输出模块（WS2812 等）"
    default n
    depends on BOARD_STM32F072RBT6 || BOARD_STM32F103CBT6 || BOARD_STM32G431CBU6
    help
      MCU 只执行带 0/1 高电平宽度的通用定时位流，WS2812 的 RGB/GRB 顺序仍由
      Linux 负责。板级后端计划使用定时器 PWM 与 DMA，避免逐位中断阻塞 CAN。

config TIMED_BITSTREAM_RESOURCE_COUNT
    int "定时位流通道编译期容量"
    range 1 2
    default 1
    depends on REMOTEBSP_TIMED_BITSTREAM

choice
    prompt "定时位流 0 输出引脚"
    depends on REMOTEBSP_TIMED_BITSTREAM
    default TIMED_BITSTREAM0_PIN_PA8

config TIMED_BITSTREAM0_PIN_PA8
    bool "PA8（TIM1_CH1，DMA）"
    depends on !REMOTEBSP_MOTION || !MOTION_PIN_PA8_USED_25

endchoice

config TIMED_BITSTREAM_MAX_BITS
    int "单次定时位流最大位数"
    range 24 12288
    default 1536 if BOARD_STM32G431CBU6
    default 768
    depends on REMOTEBSP_TIMED_BITSTREAM
    help
      768 位可驱动 32 颗 RGB 灯，1536 位可驱动 64 颗。DMA 比较值缓冲区按此上限
      消耗静态 RAM；Studio 工程决定固件实际启用的灯珠数量。

endmenu

menu "智能步进运动（可选）"

config REMOTEBSP_MOTION
    bool "编译智能步进运动模块"
    default n
    depends on BOARD_STM32F072RBT6 || BOARD_STM32F103CBT6 || BOARD_STM32G431CBU6
    help
      启用带绝对时间的多轴运动段队列和定时器 STEP 执行器。关闭时不编译
      运动源文件，也不在 Remote Core 中分配轴状态和运动段队列。

      STM32F072RBT6、STM32F103CBT6 与 STM32G431CBU6 都有独立的 STEP 定时器后端。默认预设
      只负责填写已知接线；不选择预设时仍可手工配置本板运动槽和引脚。

config REMOTEBSP_TMC2209_UART
    bool "编译 TMC2209 专用单线 UART 后端"
    default n
    depends on REMOTEBSP_MOTION
    select REMOTEBSP_SOFT_HALF_DUPLEX_UART
    help
      编译固定 40000 bit/s 的单线半双工字节事务执行器。它与硬件 USART
      独立裁剪，可同时存在；TMC 寄存器语义、CRC 和初始化策略仍由 Linux 负责。

config TMC2209_UART_PORT_CAPACITY
    int "TMC2209 单线端口编译期容量"
    range 1 5
    default 5 if BOARD_MELLOW_FLY_D5
    default 1
    depends on REMOTEBSP_TMC2209_UART
    help
      这是静态状态和逻辑对象容量，不是必须启用的实际端口数。兼容期静态槽位中，
      最高 TMC 槽号必须小于本值；运行时资源清单完成后由清单决定实际端口。

if REMOTEBSP_MOTION

rsource "Kconfig.motion_pins.generated"

endif

config MOTION_MAX_AXES
    int "本板最大运动轴数"
    range 1 5
    default 5 if BOARD_MELLOW_FLY_D5
    default 4 if BOARD_STM32F072RBT6
    default 2 if BOARD_STM32F103CBT6
    default 5 if BOARD_STM32G431CBU6
    depends on REMOTEBSP_MOTION
    help
      这是本节点编译期存储上限，不是整个系统的轴数上限。当前 F072/F103/G431
      板级适配各提供五个可配置槽；实际启用槽数量不能超过
      此值；逻辑运动组可组合多块板卡。

config MOTION_QUEUE_DEPTH
    int "运动段队列深度" if EXPERT_CONFIG
    range 2 128
    default 8 if BOARD_STM32F072RBT6
    default 8 if BOARD_STM32F103CBT6
    default 32 if BOARD_STM32G431CBU6
    depends on REMOTEBSP_MOTION

config MOTION_MIN_LEAD_TIME_US
    int "最小排程提前量（微秒）" if EXPERT_CONFIG
    range 100 1000000
    default 2000 if BOARD_STM32F072RBT6
    default 2000 if BOARD_STM32F103CBT6
    default 1000 if BOARD_STM32G431CBU6
    depends on REMOTEBSP_MOTION

config MOTION_MAX_STEP_RATE_HZ
    int "单轴最大 STEP 频率预算" if EXPERT_CONFIG
    range 1000 250000
    default 30000 if BOARD_STM32F072RBT6
    default 60000 if BOARD_STM32F103CBT6
    default 120000 if BOARD_STM32G431CBU6
    depends on REMOTEBSP_MOTION
    help
      运动段入队时使用的单轴安全预算。它不是周期中断频率；compare 调度器只在
      实际边沿到期时进入中断。实板性能验收后可以针对板型提高该值。

config MOTION_MAX_TOTAL_STEP_RATE_HZ
    int "整板总 STEP 频率预算" if EXPERT_CONFIG
    range 1000 500000
    default 30000 if BOARD_STM32F072RBT6
    default 80000 if BOARD_STM32F103CBT6
    default 200000 if BOARD_STM32G431CBU6
    depends on REMOTEBSP_MOTION
    help
      所有轴 STEP 频率之和的入队上限，用来限制最坏情况下的 compare ISR 负载。
      同时到期的多轴边沿会在一次中断中批量处理，因此实际中断数通常更低。

config MOTION_STEP_PULSE_WIDTH_US
    int "STEP 高电平宽度（微秒）" if EXPERT_CONFIG
    range 1 100
    default 8 if BOARD_STM32F072RBT6
    default 5 if BOARD_STM32F103CBT6
    default 2 if BOARD_STM32G431CBU6
    depends on REMOTEBSP_MOTION

config MOTION_MIN_STEP_LOW_US
    int "STEP 最短低电平时间（微秒）" if EXPERT_CONFIG
    range 1 100
    default 8 if BOARD_STM32F072RBT6
    default 5 if BOARD_STM32F103CBT6
    default 2 if BOARD_STM32G431CBU6
    depends on REMOTEBSP_MOTION

config MOTION_DIRECTION_SETUP_US
    int "DIR 到首个 STEP 的建立时间（微秒）" if EXPERT_CONFIG
    range 1 100
    default 8 if BOARD_STM32F072RBT6
    default 5 if BOARD_STM32F103CBT6
    default 2 if BOARD_STM32G431CBU6
    depends on REMOTEBSP_MOTION

config MOTION_COMPARE_MIN_LEAD_US
    int "定时器 compare 最小提前量（微秒）" if EXPERT_CONFIG
    range 1 100
    default 4 if BOARD_STM32F072RBT6
    default 3 if BOARD_STM32F103CBT6
    default 1 if BOARD_STM32G431CBU6
    depends on REMOTEBSP_MOTION
    help
      写入 compare 后必须至少留出的硬件计数时间。过近的边沿会向后安全顺延，
      避免比较值已经落后于计数器而等待一次完整回绕。

config MOTION_MAX_COMPARE_LATENESS_US
    int "compare 最大容许迟到（微秒）" if EXPERT_CONFIG
    range 1 1000
    default 50 if BOARD_STM32F072RBT6
    default 30 if BOARD_STM32F103CBT6
    default 10 if BOARD_STM32G431CBU6
    depends on REMOTEBSP_MOTION
    help
      超出该预算时禁止突发补发 STEP，立即锁存时序故障并关闭运动输出。

config MOTION_SLOT_LIMIT_INPUTS
    bool "启用槽 0～2 的固定限位输入"
    default n
    depends on REMOTEBSP_MOTION && BOARD_STM32F072RBT6

endmenu
menu "启动与升级"

choice
    prompt "APP Flash 布局"
    default APP_LAYOUT_STANDALONE
    help
      独立 APP 从 0x08000000 启动，适合使用 ST-Link 直接烧录。
      Katapult 布局为 Bootloader 保留前 8KiB，APP 从 0x08002000 启动。

config APP_LAYOUT_STANDALONE
    bool "独立 APP（无 Bootloader，偏移 0）"

config APP_LAYOUT_KATAPULT_8K
    bool "Katapult Bootloader（保留前 8KiB）"

endchoice

config APPLICATION_FLASH_OFFSET
    hex
    default 0x2000 if APP_LAYOUT_KATAPULT_8K
    default 0x0

endmenu
```
