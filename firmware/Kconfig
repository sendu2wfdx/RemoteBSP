## firmware/configs/stm32f072_fly_d5_defconfig
```kconfig
CONFIG_BOARD_STM32F072RBT6=y
CONFIG_BOARD_MELLOW_FLY_D5=y
CONFIG_F072_CLOCK_HSE_8MHZ=y
CONFIG_SYSTEM_CLOCK_HZ=48000000
CONFIG_FIRMWARE_VERSION_MAJOR=0
CONFIG_FIRMWARE_VERSION_MINOR=1
CONFIG_FIRMWARE_VERSION_PATCH=0
CONFIG_BOARD_TYPE=0xF072D5
CONFIG_NODE_PROVISIONAL_ID=1
CONFIG_CAN_PINS_PB8_PB9=y
CONFIG_CAN_NOMINAL_BITRATE=1000000
CONFIG_REMOTE_MAX_PACKET_SIZE=2048
CONFIG_REMOTE_REQUEST_CACHE_ENTRIES=8
CONFIG_REMOTE_CACHE_RESPONSE_SIZE=256
CONFIG_REMOTE_REASSEMBLY_SLOTS=2
CONFIG_REMOTE_REASSEMBLY_TIMEOUT_MS=500
CONFIG_HEARTBEAT_INTERVAL_MS=500
CONFIG_STARTUP_GPIO_OUTPUT_LOW=""
CONFIG_STARTUP_GPIO_OUTPUT_HIGH=""
CONFIG_GPIO_RESOURCE_COUNT=16
CONFIG_UART_RX_BUFFER_SIZE=256
CONFIG_UART_TX_BUFFER_SIZE=256
CONFIG_REMOTEBSP_MOTION=n
CONFIG_APP_LAYOUT_STANDALONE=y
CONFIG_APPLICATION_FLASH_OFFSET=0x0
```

## firmware/configs/stm32f072_fly_d5_katapult_defconfig
```kconfig
CONFIG_BOARD_STM32F072RBT6=y
CONFIG_BOARD_MELLOW_FLY_D5=y
CONFIG_F072_CLOCK_HSE_8MHZ=y
CONFIG_SYSTEM_CLOCK_HZ=48000000
CONFIG_FIRMWARE_VERSION_MAJOR=0
CONFIG_FIRMWARE_VERSION_MINOR=1
CONFIG_FIRMWARE_VERSION_PATCH=0
CONFIG_BOARD_TYPE=0xF072D5
CONFIG_NODE_PROVISIONAL_ID=1
CONFIG_CAN_PINS_PB8_PB9=y
CONFIG_CAN_NOMINAL_BITRATE=1000000
CONFIG_REMOTE_MAX_PACKET_SIZE=2048
CONFIG_REMOTE_REQUEST_CACHE_ENTRIES=8
CONFIG_REMOTE_CACHE_RESPONSE_SIZE=256
CONFIG_REMOTE_REASSEMBLY_SLOTS=2
CONFIG_REMOTE_REASSEMBLY_TIMEOUT_MS=500
CONFIG_HEARTBEAT_INTERVAL_MS=500
CONFIG_STARTUP_GPIO_OUTPUT_LOW=""
CONFIG_STARTUP_GPIO_OUTPUT_HIGH=""
CONFIG_GPIO_RESOURCE_COUNT=16
CONFIG_UART_RX_BUFFER_SIZE=256
CONFIG_UART_TX_BUFFER_SIZE=256
CONFIG_REMOTEBSP_SOFT_HALF_DUPLEX_UART=y
CONFIG_SOFT_HALF_DUPLEX_UART_BAUD=40000
CONFIG_SOFT_HALF_DUPLEX_UART_RX_BUFFER_SIZE=64
CONFIG_SOFT_HALF_DUPLEX_UART_PORT_COUNT=5
CONFIG_MOTION_SLOT0_STEP_PIN=47
CONFIG_MOTION_SLOT0_DIR_PIN=46
CONFIG_MOTION_SLOT0_ENABLE_PIN=34
CONFIG_MOTION_SLOT0_DRIVER_TMC2209_UART=y
CONFIG_MOTION_SLOT0_TMC_UART_PIN=45
CONFIG_MOTION_SLOT0_ENABLE_ACTIVE_LOW=y
CONFIG_MOTION_SLOT0_LIMIT_PIN=20
CONFIG_MOTION_SLOT1_STEP_PIN=1
CONFIG_MOTION_SLOT1_DIR_PIN=0
CONFIG_MOTION_SLOT1_ENABLE_PIN=2
CONFIG_MOTION_SLOT1_DRIVER_TMC2209_UART=y
CONFIG_MOTION_SLOT1_TMC_UART_PIN=35
CONFIG_MOTION_SLOT1_ENABLE_ACTIVE_LOW=y
CONFIG_MOTION_SLOT1_LIMIT_PIN=19
CONFIG_MOTION_SLOT2_STEP_PIN=5
CONFIG_MOTION_SLOT2_DIR_PIN=4
CONFIG_MOTION_SLOT2_ENABLE_PIN=6
CONFIG_MOTION_SLOT2_DRIVER_TMC2209_UART=y
CONFIG_MOTION_SLOT2_TMC_UART_PIN=3
CONFIG_MOTION_SLOT2_ENABLE_ACTIVE_LOW=y
CONFIG_MOTION_SLOT2_LIMIT_PIN=50
CONFIG_MOTION_SLOT3_STEP_PIN=26
CONFIG_MOTION_SLOT3_DIR_PIN=18
CONFIG_MOTION_SLOT3_ENABLE_PIN=27
CONFIG_MOTION_SLOT3_DRIVER_TMC2209_UART=y
CONFIG_MOTION_SLOT3_TMC_UART_PIN=17
CONFIG_MOTION_SLOT3_ENABLE_ACTIVE_LOW=y
CONFIG_MOTION_SLOT3_LIMIT_PIN=-1
CONFIG_MOTION_SLOT4_STEP_PIN=37
CONFIG_MOTION_SLOT4_DIR_PIN=36
CONFIG_MOTION_SLOT4_ENABLE_PIN=16
CONFIG_MOTION_SLOT4_DRIVER_TMC2209_UART=y
CONFIG_MOTION_SLOT4_TMC_UART_PIN=7
CONFIG_MOTION_SLOT4_ENABLE_ACTIVE_LOW=y
CONFIG_MOTION_SLOT4_LIMIT_PIN=-1
CONFIG_REMOTEBSP_MOTION=y
CONFIG_MOTION_MAX_AXES=5
CONFIG_MOTION_QUEUE_DEPTH=8
CONFIG_MOTION_MIN_LEAD_TIME_US=2000
CONFIG_MOTION_TIMER_HZ=10000
CONFIG_MOTION_SLOT0_ENABLED=y
CONFIG_MOTION_SLOT1_ENABLED=y
CONFIG_MOTION_SLOT2_ENABLED=y
CONFIG_MOTION_SLOT3_ENABLED=y
CONFIG_MOTION_SLOT4_ENABLED=y
CONFIG_APP_LAYOUT_KATAPULT_8K=y
CONFIG_APPLICATION_FLASH_OFFSET=0x2000
```

## firmware/configs/stm32f072rbt6_defconfig
```kconfig
CONFIG_BOARD_STM32F072RBT6=y
CONFIG_SYSTEM_CLOCK_HZ=48000000
CONFIG_FIRMWARE_VERSION_MAJOR=0
CONFIG_FIRMWARE_VERSION_MINOR=1
CONFIG_FIRMWARE_VERSION_PATCH=0
CONFIG_BOARD_TYPE=0x0072B6
CONFIG_NODE_PROVISIONAL_ID=1
CONFIG_CAN_PINS_PA11_PA12=y
CONFIG_CAN_NOMINAL_BITRATE=500000
CONFIG_REMOTE_MAX_PACKET_SIZE=2048
CONFIG_REMOTE_REQUEST_CACHE_ENTRIES=8
CONFIG_REMOTE_CACHE_RESPONSE_SIZE=256
CONFIG_REMOTE_REASSEMBLY_SLOTS=2
CONFIG_REMOTE_REASSEMBLY_TIMEOUT_MS=500
CONFIG_HEARTBEAT_INTERVAL_MS=500
CONFIG_GPIO_RESOURCE_COUNT=8
CONFIG_HARDWARE_UART_RESOURCE_COUNT=1
CONFIG_UART0_PINS_PA9_PA10=y
CONFIG_UART_RX_BUFFER_SIZE=256
CONFIG_UART_TX_BUFFER_SIZE=256
CONFIG_REMOTEBSP_MOTION=n
CONFIG_APP_LAYOUT_STANDALONE=y
CONFIG_APPLICATION_FLASH_OFFSET=0x0
```

## firmware/configs/stm32f103_bluepill_defconfig
```kconfig
CONFIG_BOARD_STM32F103CBT6=y
CONFIG_BOARD_WEACT_BLUEPILL_PLUS=y
CONFIG_STARTUP_GPIO_OUTPUT_LOW="PB2"
CONFIG_STARTUP_GPIO_INPUT_PULLDOWN="PA0"
CONFIG_SYSTEM_CLOCK_HZ=72000000
CONFIG_FIRMWARE_VERSION_MAJOR=0
CONFIG_FIRMWARE_VERSION_MINOR=1
CONFIG_FIRMWARE_VERSION_PATCH=0
CONFIG_BOARD_TYPE=0x0103CB
CONFIG_NODE_PROVISIONAL_ID=1
CONFIG_CAN_PINS_PB8_PB9=y
CONFIG_CAN_NOMINAL_BITRATE=1000000
CONFIG_REMOTE_MAX_PACKET_SIZE=2048
CONFIG_REMOTE_REQUEST_CACHE_ENTRIES=8
CONFIG_REMOTE_CACHE_RESPONSE_SIZE=256
CONFIG_REMOTE_REASSEMBLY_SLOTS=2
CONFIG_REMOTE_REASSEMBLY_TIMEOUT_MS=500
CONFIG_HEARTBEAT_INTERVAL_MS=500
CONFIG_GPIO_RESOURCE_COUNT=8
CONFIG_UART_RESOURCE_COUNT=1
CONFIG_UART0_PINS_PA9_PA10=y
CONFIG_UART_RX_BUFFER_SIZE=256
CONFIG_UART_TX_BUFFER_SIZE=256
CONFIG_REMOTEBSP_MOTION=n
CONFIG_APP_LAYOUT_STANDALONE=y
CONFIG_APPLICATION_FLASH_OFFSET=0x0
```

## firmware/configs/stm32f103_weact_bluepill_plus_defconfig
```kconfig
# WeAct BluePill Plus 独立 APP 预设。
CONFIG_BOARD_STM32F103CBT6=y
CONFIG_BOARD_WEACT_BLUEPILL_PLUS=y
CONFIG_WEACT_BLUEPILL_PLUS_PB2_BREATHING_LED=y
CONFIG_STARTUP_GPIO_OUTPUT_LOW="PB2"
CONFIG_STARTUP_GPIO_INPUT_PULLDOWN="PA0"
CONFIG_SYSTEM_CLOCK_HZ=72000000
CONFIG_FIRMWARE_VERSION_MAJOR=0
CONFIG_FIRMWARE_VERSION_MINOR=1
CONFIG_FIRMWARE_VERSION_PATCH=0
CONFIG_BOARD_TYPE=0x0103CB
CONFIG_NODE_PROVISIONAL_ID=1
CONFIG_CAN_PINS_PB8_PB9=y
CONFIG_CAN_NOMINAL_BITRATE=1000000
CONFIG_REMOTE_MAX_PACKET_SIZE=2048
CONFIG_REMOTE_REQUEST_CACHE_ENTRIES=8
CONFIG_REMOTE_CACHE_RESPONSE_SIZE=256
CONFIG_REMOTE_REASSEMBLY_SLOTS=2
CONFIG_REMOTE_REASSEMBLY_TIMEOUT_MS=500
CONFIG_HEARTBEAT_INTERVAL_MS=500
CONFIG_GPIO_RESOURCE_COUNT=8
CONFIG_REMOTEBSP_PWM=y
CONFIG_PWM_RESOURCE_COUNT=1
CONFIG_PWM0_PIN_PA6=y
CONFIG_PWM_MAX_FREQUENCY_HZ=100000
CONFIG_REMOTEBSP_TIMED_BITSTREAM=y
CONFIG_TIMED_BITSTREAM_RESOURCE_COUNT=1
CONFIG_TIMED_BITSTREAM0_PIN_PA8=y
CONFIG_TIMED_BITSTREAM_MAX_BITS=768
CONFIG_HARDWARE_UART_RESOURCE_COUNT=1
CONFIG_UART0_PINS_PA9_PA10=y
CONFIG_UART_RX_BUFFER_SIZE=256
CONFIG_UART_TX_BUFFER_SIZE=256
CONFIG_REMOTEBSP_MOTION=n
CONFIG_APP_LAYOUT_STANDALONE=y
CONFIG_APPLICATION_FLASH_OFFSET=0x0
```

## firmware/configs/stm32f103_weact_bluepill_plus_katapult_defconfig
```kconfig
# WeAct BluePill Plus APP（Katapult 8 KiB 布局）预设。
CONFIG_BOARD_STM32F103CBT6=y
CONFIG_BOARD_WEACT_BLUEPILL_PLUS=y
CONFIG_F103_CLOCK_HSE_8MHZ=y
CONFIG_BOARD_HAS_LSE_32768=y
CONFIG_WEACT_BLUEPILL_PLUS_PB2_BREATHING_LED=y
CONFIG_STARTUP_GPIO_OUTPUT_LOW="PB2"
CONFIG_STARTUP_GPIO_INPUT_PULLDOWN="PA0"
CONFIG_SYSTEM_CLOCK_HZ=72000000
CONFIG_FIRMWARE_VERSION_MAJOR=0
CONFIG_FIRMWARE_VERSION_MINOR=1
CONFIG_FIRMWARE_VERSION_PATCH=0
CONFIG_BOARD_TYPE=0x0103CB
CONFIG_NODE_PROVISIONAL_ID=1
CONFIG_CAN_PINS_PB8_PB9=y
CONFIG_CAN_NOMINAL_BITRATE=1000000
CONFIG_REMOTE_MAX_PACKET_SIZE=2048
CONFIG_REMOTE_REQUEST_CACHE_ENTRIES=8
CONFIG_REMOTE_CACHE_RESPONSE_SIZE=256
CONFIG_REMOTE_REASSEMBLY_SLOTS=2
CONFIG_REMOTE_REASSEMBLY_TIMEOUT_MS=500
CONFIG_HEARTBEAT_INTERVAL_MS=500
CONFIG_GPIO_RESOURCE_COUNT=8
CONFIG_HARDWARE_UART_RESOURCE_COUNT=1
CONFIG_UART0_PINS_PA9_PA10=y
CONFIG_UART_RX_BUFFER_SIZE=256
CONFIG_UART_TX_BUFFER_SIZE=256
CONFIG_REMOTEBSP_MOTION=n
CONFIG_APP_LAYOUT_KATAPULT_8K=y
CONFIG_APPLICATION_FLASH_OFFSET=0x2000
```

## firmware/configs/stm32f103_weact_bluepill_plus_motion_5axis_tmc2209_defconfig
```kconfig
# WeAct BluePill Plus 五轴 TMC2209 独立 APP 预设。
CONFIG_BOARD_STM32F103CBT6=y
CONFIG_BOARD_WEACT_BLUEPILL_PLUS=y
CONFIG_F103_CLOCK_HSE_8MHZ=y
CONFIG_BOARD_HAS_LSE_32768=y
CONFIG_WEACT_BLUEPILL_PLUS_PB2_BREATHING_LED=y
CONFIG_STARTUP_GPIO_OUTPUT_LOW="PB2"
CONFIG_STARTUP_GPIO_INPUT_PULLDOWN="PA0"
CONFIG_SYSTEM_CLOCK_HZ=72000000
CONFIG_FIRMWARE_VERSION_MAJOR=0
CONFIG_FIRMWARE_VERSION_MINOR=1
CONFIG_FIRMWARE_VERSION_PATCH=0
CONFIG_BOARD_TYPE=0x0103CB
CONFIG_NODE_PROVISIONAL_ID=1
CONFIG_CAN_PINS_PB8_PB9=y
CONFIG_CAN_NOMINAL_BITRATE=1000000
CONFIG_REMOTE_MAX_PACKET_SIZE=2048
CONFIG_REMOTE_REQUEST_CACHE_ENTRIES=8
CONFIG_REMOTE_CACHE_RESPONSE_SIZE=256
CONFIG_REMOTE_REASSEMBLY_SLOTS=2
CONFIG_REMOTE_REASSEMBLY_TIMEOUT_MS=500
CONFIG_HEARTBEAT_INTERVAL_MS=500
CONFIG_GPIO_RESOURCE_COUNT=8
CONFIG_HARDWARE_UART_RESOURCE_COUNT=1
CONFIG_REMOTEBSP_MOTION=y
CONFIG_REMOTEBSP_TMC2209_UART=y
CONFIG_TMC2209_UART_PORT_CAPACITY=5
CONFIG_MOTION_SLOT0_ENABLED=y
CONFIG_MOTION_SLOT0_STEP_PIN_PA1=y
CONFIG_MOTION_SLOT0_DIR_PIN_PA2=y
CONFIG_MOTION_SLOT0_ENABLE_PIN_PA3=y
CONFIG_MOTION_SLOT0_DRIVER_TMC2209_UART=y
CONFIG_MOTION_SLOT0_TMC_UART_PIN_PA4=y
CONFIG_MOTION_SLOT0_DIR_INVERTED=n
CONFIG_MOTION_SLOT0_ENABLE_ACTIVE_LOW_SETTING=y
CONFIG_MOTION_SLOT0_LIMIT_PIN_NONE=y
CONFIG_MOTION_SLOT1_ENABLED=y
CONFIG_MOTION_SLOT1_STEP_PIN_PA5=y
CONFIG_MOTION_SLOT1_DIR_PIN_PA6=y
CONFIG_MOTION_SLOT1_ENABLE_PIN_PA7=y
CONFIG_MOTION_SLOT1_DRIVER_TMC2209_UART=y
CONFIG_MOTION_SLOT1_TMC_UART_PIN_PA8=y
CONFIG_MOTION_SLOT1_DIR_INVERTED=n
CONFIG_MOTION_SLOT1_ENABLE_ACTIVE_LOW_SETTING=y
CONFIG_MOTION_SLOT1_LIMIT_PIN_NONE=y
CONFIG_MOTION_SLOT2_ENABLED=y
CONFIG_MOTION_SLOT2_STEP_PIN_PA15=y
CONFIG_MOTION_SLOT2_DIR_PIN_PB0=y
CONFIG_MOTION_SLOT2_ENABLE_PIN_PB1=y
CONFIG_MOTION_SLOT2_DRIVER_TMC2209_UART=y
CONFIG_MOTION_SLOT2_TMC_UART_PIN_PC13=y
CONFIG_MOTION_SLOT2_DIR_INVERTED=n
CONFIG_MOTION_SLOT2_ENABLE_ACTIVE_LOW_SETTING=y
CONFIG_MOTION_SLOT2_LIMIT_PIN_NONE=y
CONFIG_MOTION_SLOT3_ENABLED=y
CONFIG_MOTION_SLOT3_STEP_PIN_PB3=y
CONFIG_MOTION_SLOT3_DIR_PIN_PB4=y
CONFIG_MOTION_SLOT3_ENABLE_PIN_PB5=y
CONFIG_MOTION_SLOT3_DRIVER_TMC2209_UART=y
CONFIG_MOTION_SLOT3_TMC_UART_PIN_PB6=y
CONFIG_MOTION_SLOT3_DIR_INVERTED=n
CONFIG_MOTION_SLOT3_ENABLE_ACTIVE_LOW_SETTING=y
CONFIG_MOTION_SLOT3_LIMIT_PIN_NONE=y
CONFIG_MOTION_SLOT4_ENABLED=y
CONFIG_MOTION_SLOT4_STEP_PIN_PB7=y
CONFIG_MOTION_SLOT4_DIR_PIN_PB10=y
CONFIG_MOTION_SLOT4_ENABLE_PIN_PB11=y
CONFIG_MOTION_SLOT4_DRIVER_TMC2209_UART=y
CONFIG_MOTION_SLOT4_TMC_UART_PIN_PB12=y
CONFIG_MOTION_SLOT4_DIR_INVERTED=n
CONFIG_MOTION_SLOT4_ENABLE_ACTIVE_LOW_SETTING=y
CONFIG_MOTION_SLOT4_LIMIT_PIN_NONE=y
CONFIG_MOTION_MAX_AXES=5
CONFIG_MOTION_QUEUE_DEPTH=8
CONFIG_MOTION_MIN_LEAD_TIME_US=2000
CONFIG_MOTION_MAX_STEP_RATE_HZ=50000
CONFIG_MOTION_MAX_TOTAL_STEP_RATE_HZ=80000
CONFIG_MOTION_STEP_PULSE_WIDTH_US=5
CONFIG_MOTION_MIN_STEP_LOW_US=5
CONFIG_MOTION_DIRECTION_SETUP_US=5
CONFIG_MOTION_COMPARE_MIN_LEAD_US=3
CONFIG_MOTION_MAX_COMPARE_LATENESS_US=30
CONFIG_APP_LAYOUT_STANDALONE=y
CONFIG_APPLICATION_FLASH_OFFSET=0x0
```

## firmware/configs/stm32f103cbt6_motion_5axis_tmc2209_defconfig
```kconfig
# 五轴 TMC2209 专用通讯配置。
CONFIG_BOARD_STM32F103CBT6=y
CONFIG_SYSTEM_CLOCK_HZ=72000000
CONFIG_FIRMWARE_VERSION_MAJOR=0
CONFIG_FIRMWARE_VERSION_MINOR=1
CONFIG_FIRMWARE_VERSION_PATCH=0
CONFIG_BOARD_TYPE=0x0103CB
CONFIG_NODE_PROVISIONAL_ID=1
CONFIG_CAN_PINS_PA11_PA12=y
CONFIG_CAN_NOMINAL_BITRATE=500000
CONFIG_REMOTE_MAX_PACKET_SIZE=2048
CONFIG_REMOTE_REQUEST_CACHE_ENTRIES=8
CONFIG_REMOTE_CACHE_RESPONSE_SIZE=256
CONFIG_REMOTE_REASSEMBLY_SLOTS=2
CONFIG_REMOTE_REASSEMBLY_TIMEOUT_MS=500
CONFIG_HEARTBEAT_INTERVAL_MS=500
CONFIG_GPIO_RESOURCE_COUNT=8
CONFIG_UART_RESOURCE_COUNT=5
CONFIG_REMOTEBSP_MOTION=y
CONFIG_REMOTEBSP_SOFT_HALF_DUPLEX_UART=y
CONFIG_SOFT_HALF_DUPLEX_UART_BAUD=40000
CONFIG_SOFT_HALF_DUPLEX_UART_RX_BUFFER_SIZE=64
CONFIG_SOFT_HALF_DUPLEX_UART_PORT_COUNT=5
CONFIG_MOTION_SLOT0_ENABLED=y
CONFIG_MOTION_SLOT0_STEP_PIN=0
CONFIG_MOTION_SLOT0_DIR_PIN=1
CONFIG_MOTION_SLOT0_ENABLE_PIN=2
CONFIG_MOTION_SLOT0_DRIVER_TMC2209_UART=y
CONFIG_MOTION_SLOT0_TMC_UART_PIN=3
CONFIG_MOTION_SLOT0_DIR_INVERTED=n
CONFIG_MOTION_SLOT0_ENABLE_ACTIVE_LOW=y
CONFIG_MOTION_SLOT0_LIMIT_PIN=-1
CONFIG_MOTION_SLOT1_ENABLED=y
CONFIG_MOTION_SLOT1_STEP_PIN=4
CONFIG_MOTION_SLOT1_DIR_PIN=5
CONFIG_MOTION_SLOT1_ENABLE_PIN=6
CONFIG_MOTION_SLOT1_DRIVER_TMC2209_UART=y
CONFIG_MOTION_SLOT1_TMC_UART_PIN=7
CONFIG_MOTION_SLOT1_DIR_INVERTED=n
CONFIG_MOTION_SLOT1_ENABLE_ACTIVE_LOW=y
CONFIG_MOTION_SLOT1_LIMIT_PIN=-1
CONFIG_MOTION_SLOT2_ENABLED=y
CONFIG_MOTION_SLOT2_STEP_PIN=8
CONFIG_MOTION_SLOT2_DIR_PIN=9
CONFIG_MOTION_SLOT2_ENABLE_PIN=10
CONFIG_MOTION_SLOT2_DRIVER_TMC2209_UART=y
CONFIG_MOTION_SLOT2_TMC_UART_PIN=16
CONFIG_MOTION_SLOT2_DIR_INVERTED=n
CONFIG_MOTION_SLOT2_ENABLE_ACTIVE_LOW=y
CONFIG_MOTION_SLOT2_LIMIT_PIN=-1
CONFIG_MOTION_SLOT3_ENABLED=y
CONFIG_MOTION_SLOT3_STEP_PIN=17
CONFIG_MOTION_SLOT3_DIR_PIN=19
CONFIG_MOTION_SLOT3_ENABLE_PIN=20
CONFIG_MOTION_SLOT3_DRIVER_TMC2209_UART=y
CONFIG_MOTION_SLOT3_TMC_UART_PIN=21
CONFIG_MOTION_SLOT3_DIR_INVERTED=n
CONFIG_MOTION_SLOT3_ENABLE_ACTIVE_LOW=y
CONFIG_MOTION_SLOT3_LIMIT_PIN=-1
CONFIG_MOTION_SLOT4_ENABLED=y
CONFIG_MOTION_SLOT4_STEP_PIN=22
CONFIG_MOTION_SLOT4_DIR_PIN=23
CONFIG_MOTION_SLOT4_ENABLE_PIN=26
CONFIG_MOTION_SLOT4_DRIVER_TMC2209_UART=y
CONFIG_MOTION_SLOT4_TMC_UART_PIN=27
CONFIG_MOTION_SLOT4_DIR_INVERTED=n
CONFIG_MOTION_SLOT4_ENABLE_ACTIVE_LOW=y
CONFIG_MOTION_SLOT4_LIMIT_PIN=-1
CONFIG_MOTION_MAX_AXES=5
CONFIG_MOTION_QUEUE_DEPTH=8
CONFIG_MOTION_MIN_LEAD_TIME_US=2000
CONFIG_MOTION_TIMER_HZ=100000
CONFIG_APP_LAYOUT_STANDALONE=y
CONFIG_APPLICATION_FLASH_OFFSET=0x0
```

## firmware/configs/stm32g431_weact_core_katapult_defconfig
```kconfig
# WeAct STM32G431CBU6 Core APP（Katapult 8 KiB 布局）预设。
CONFIG_BOARD_STM32G431CBU6=y
CONFIG_BOARD_WEACT_G431_CORE_V10=y
CONFIG_G431_CLOCK_HSE_8MHZ=y
CONFIG_BOARD_HAS_LSE_32768=y
CONFIG_WEACT_G431_PC6_PWM_BREATHING_LED=y
CONFIG_STARTUP_GPIO_OUTPUT_LOW="PC6"
CONFIG_STARTUP_GPIO_INPUT_PULLDOWN="PC13"
CONFIG_SYSTEM_CLOCK_HZ=170000000
CONFIG_FIRMWARE_VERSION_MAJOR=0
CONFIG_FIRMWARE_VERSION_MINOR=1
CONFIG_FIRMWARE_VERSION_PATCH=0
CONFIG_BOARD_TYPE=0x0431CB
CONFIG_NODE_PROVISIONAL_ID=1
CONFIG_CAN_PINS_PB8_PB9=y
CONFIG_CAN_NOMINAL_BITRATE=500000
CONFIG_CAN_FD_ENABLE=y
CONFIG_CAN_FD_DATA_BITRATE=1000000
CONFIG_REMOTE_MAX_PACKET_SIZE=2048
CONFIG_REMOTE_REQUEST_CACHE_ENTRIES=16
CONFIG_REMOTE_CACHE_RESPONSE_SIZE=256
CONFIG_REMOTE_REASSEMBLY_SLOTS=2
CONFIG_REMOTE_REASSEMBLY_TIMEOUT_MS=500
CONFIG_HEARTBEAT_INTERVAL_MS=500
CONFIG_GPIO_RESOURCE_COUNT=8
CONFIG_HARDWARE_UART_RESOURCE_COUNT=3
CONFIG_UART_RX_BUFFER_SIZE=1024
CONFIG_UART_TX_BUFFER_SIZE=1024
CONFIG_REMOTEBSP_MOTION=n
CONFIG_APP_LAYOUT_KATAPULT_8K=y
CONFIG_APPLICATION_FLASH_OFFSET=0x2000
```
